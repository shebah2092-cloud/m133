## AndroidApp/app/src/main/cpp/PX4-Autopilot/src/drivers/xqpower_can/Kconfig
```kconfig
menuconfig DRIVERS_XQPOWER_CAN
	bool "xqpower_can"
	default n
	---help---
		Enable XQPOWER CAN Bus Servo driver.
		Controls up to 4 XQPOWER servos via CAN bus
		using CANopen SDO/PDO protocol on MicoAir H743.
```

## AndroidApp/app/src/main/cpp/PX4-Autopilot/src/modules/rocket_mpc/Kconfig
```kconfig
menuconfig MODULES_ROCKET_MPC
	bool "rocket_mpc"
	default n
	---help---
		Enable support for rocket_mpc (M130 MPC+MHE via acados — replaces rocket_gnc)
```
